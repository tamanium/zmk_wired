/*
 * Copyright (c) 2022 The ZMK Contributors
 *
 * SPDX-License-Identifier: MIT
 */

#include "asym.dtsi"
&kscan0 {
	compatible = "zmk,kscan-gpio-matrix";
	diode-direction = "col2row";
	col-gpios =
		<&core_a   7 GPIO_ACTIVE_HIGH>,
		<&core_a   5 GPIO_ACTIVE_HIGH>,
		<&core_a   8 GPIO_ACTIVE_HIGH>,
		<&core_a   9 GPIO_ACTIVE_HIGH>,
		<&core_a  10 GPIO_ACTIVE_HIGH>,
		<&core_a  29 GPIO_ACTIVE_HIGH>;
	row-gpios =
		<&core_a   4 (GPIO_ACTIVE_HIGH | GPIO_PULL_DOWN)>,
		<&core_a   3 (GPIO_ACTIVE_HIGH | GPIO_PULL_DOWN)>,
		<&core_a   6 (GPIO_ACTIVE_HIGH | GPIO_PULL_DOWN)>,
		<&core_a  26 (GPIO_ACTIVE_HIGH | GPIO_PULL_DOWN)>;
};