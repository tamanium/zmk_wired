## config/boards/shields/asym/Kconfig.defconfig
```kconfig
# Copyright (c) 2022 The ZMK Contributors
# SPDX-License-Identifier: MIT

config ZMK_SPLIT_ROLE_CENTRAL
    default y
    
if SHIELD_LEFT

config ZMK_KEYBOARD_NAME
	default "asym_left"
	    
endif

if SHIELD_RIGHT

config ZMK_KEYBOARD_NAME
	default "asym_right"
    
endif
```

## config/boards/shields/asym_ble/Kconfig.defconfig
```kconfig
# Copyright (c) 2022 The ZMK Contributors
# SPDX-License-Identifier: MIT

# 左シールド
if SHIELD_LEFT
	# キーボード名
	config ZMK_KEYBOARD_NAME
		default "asym_ble"
	# セントラル設定
	config ZMK_SPLIT_ROLE_CENTRAL
		default y
endif

if SHIELD_LEFT || SHIELD_RIGHT
	# 分割設定
	config ZMK_SPLIT
		default y
endif
```

## config/boards/shields/asym_ble/Kconfig.shield
```kconfig
# Copyright (c) 2022 The ZMK Contributors
# SPDX-License-Identifier: MIT

config SHIELD_LEFT
	def_bool $(shields_list_contains,asym_ble_lefttest)

config SHIELD_RIGHT
	def_bool $(shields_list_contains,asym_ble_right)
```

## config/boards/shields/asym_left/Kconfig.shield
```kconfig
# Copyright (c) 2022 The ZMK Contributors
# SPDX-License-Identifier: MIT

config SHIELD_LEFT
	def_bool $(shields_list_contains,asym_left)
```

## config/boards/shields/reset/Kconfig.shield
```kconfig
# Copyright (c) 2022 The ZMK Contributors
# SPDX-License-Identifier: MIT

config SHIELD_RESET
	def_bool $(shields_list_contains,setting_reset)
```

## config/west.yml
```yaml
#全体通して不明　しかし変える必要もなさそうなので触れないでおく
manifest:
  remotes:
    - name: zmkfirmware
      url-base: https://github.com/zmkfirmware
  projects:
    - name: zmk
      remote: zmkfirmware
      revision: main
      import: app/west.yml
  self:
    path: config
```
